## conf/layer.conf
```bitbake
BBPATH =. "${LAYERDIR}:"

BBFILES += "${LAYERDIR}/recipes-*/*/*.bb \
            ${LAYERDIR}/recipes-*/*/*.bbappend"

BBFILE_COLLECTIONS += "meta-buildutils"
BBFILE_PATTERN_meta-buildutils = "^${LAYERDIR}/"
BBFILE_PRIORITY_meta-buildutils = "6"

LAYERVERSION_meta-buildutils = "1"
LAYERDEPENDS_meta-buildutils = "core"

LAYERSERIES_COMPAT_meta-buildutils = "dunfell gatesgarth hardknott honister kirkstone langdale mickledore nanbield scarthgap styhead walnascar"
```
